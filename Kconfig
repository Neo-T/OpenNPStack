## Kconfig
```kconfig
# Kconfig file for package onps
menuconfig PKG_USING_ONPS
    bool "Onps: An open-source network protocol stack."
    default n

if PKG_USING_ONPS

    config PKG_ONPS_PATH
        string
        default "/packages/system/onps"

    choice
        prompt "Onps Version"
        default PKG_USING_ONPS_LATEST_VERSION
        help
            Select the package version

        config PKG_USING_ONPS_V110
            bool "v1.1.0"

        config PKG_USING_ONPS_LATEST_VERSION
            bool "latest"
    endchoice

    config PKG_ONPS_VER
       string
       default "v1.1.0"    if PKG_USING_ONPS_V110
       default "latest"    if PKG_USING_ONPS_LATEST_VERSION

endif
```
